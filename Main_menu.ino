
#include "Game_mode.h"
#include "globals.h"
#include "IRprototype.h"
#include "Marauderprototype.h"
#include "SubGHz.h"
#include "Rfid_Nfc.h"
#include "Bluetooth.h"

// Function Prototypes
void InitIR();
void gameSetup();
void Intinfc();
void InitSubGHz();
void InitBluetooth();
void InitMarauder();
void gameLoop();
void displayStartingMenu();

U8G2_SH1106_128X64_NONAME_F_HW_I2C u8g2(U8G2_R0, /* reset=*/ U8X8_PIN_NONE);

const int BUTTON_SELECT = 27;
const int BUTTON_BACK = 26;

const int BUTTON_UP = 201;
const int BUTTON_DOWN = 202;
const int BUTTON_LEFT = 203;
const int BUTTON_RIGHT = 204;
const int ANALOG_BUTTONS_PIN = 34; 

// ============================================================
// READ ANALOG BUTTON
// ============================================================

int readAnalogButton() {

  long total = 0;

  for (int i = 0; i < 5; i++) {
    total += analogRead(ANALOG_BUTTONS_PIN);
    delayMicroseconds(300);
  }

  int adc = total / 5;


  // ----------------------------------------------------------
  // Your measured values:
  //
  // NOTHING : ~4070
  // UP      : ~1890
  // DOWN    : ~1116
  // LEFT    : ~567
  // RIGHT   : ~214
  // ----------------------------------------------------------


  if (adc < 390) {
    return BUTTON_RIGHT;
  }

  if (adc < 840) {
    return BUTTON_LEFT;
  }

  if (adc < 1500) {
    return BUTTON_DOWN;
  }

  if (adc < 2900) {
    return BUTTON_UP;
  }

  return -1;
}

// ============================================================
// READ ANY BUTTON
// ============================================================

int readButton(int buttonId) {

  // SELECT
  if (buttonId == BUTTON_SELECT) {
    return digitalRead(BUTTON_SELECT);
  }

  // BACK
  if (buttonId == BUTTON_BACK) {
    return digitalRead(BUTTON_BACK);
  }

  // Analog buttons
  if (buttonId == BUTTON_UP ||
      buttonId == BUTTON_DOWN ||
      buttonId == BUTTON_LEFT ||
      buttonId == BUTTON_RIGHT) {

    return (readAnalogButton() == buttonId) ? LOW : HIGH;
  }

  return HIGH;
}
// Define the string for saving tag data
String currentName = "";

// Define the keyboard layout
const char* keyboard[4][10] = {
  {"A", "B", "C", "D", "E", "F", "G", "H", "I", "J"},
  {"K", "L", "M", "N", "O", "P", "Q", "R", "S", "T"},
  {"U", "V", "W", "X", "Y", "Z", "0", "1", "2", "3"},
  {"4", "5", "6", "7", "8", "9", "<", "^", "OK", "_"}
};

// Define keyboard navigation indexes
int currentRow = 0;
int currentCol = 0;
const int maxRows = 4;  // 4 rows in the keyboard layout
const int maxCols = 10;
int totalOptions = 0;
int selectedOption = 0;
bool useSD = true;
bool menuDisplayed = false;
bool menuActive = true;  // Flag to control menu flow

Mode currentMode = MENU;

bool sdAvailable() {
  return useSD && SD.cardType() != CARD_NONE;
}

void showUniversalKeyboard() {
  u8g2.clearBuffer();
  u8g2.setFont(u8g2_font_5x7_tr);
  u8g2.setCursor(0, 7);
  u8g2.print(currentName);

  for (int row = 0; row < maxRows; row++) {
    for (int col = 0; col < maxCols; col++) {
      const char* key = keyboard[row][col];
      if (key[0] == '\0') continue;
      int x = col * 12 + 1;
      int y = 17 + row * 12;
      if (row == currentRow && col == currentCol) {
        u8g2.drawBox(x - 1, y - 8, 11, 10);
        u8g2.setDrawColor(0);
      }
      u8g2.setCursor(x, y);
      u8g2.print(key);
      u8g2.setDrawColor(1);
    }
  }
  u8g2.sendBuffer();
}

bool handleUniversalKeyboardInput() {
  currentName = "";
  currentRow = 0;
  currentCol = 0;
  while (true) {
    showUniversalKeyboard();
    if (readButton(BUTTON_UP) == LOW) {
      currentRow = (currentRow - 1 + maxRows) % maxRows;
      delay(150);
    } else if (readButton(BUTTON_DOWN) == LOW) {
      currentRow = (currentRow + 1) % maxRows;
      delay(150);
    } else if (readButton(BUTTON_LEFT) == LOW) {
      currentCol = (currentCol - 1 + maxCols) % maxCols;
      delay(150);
    } else if (readButton(BUTTON_RIGHT) == LOW) {
      currentCol = (currentCol + 1) % maxCols;
      delay(150);
    } else if (readButton(BUTTON_SELECT) == LOW) {
      const char* key = keyboard[currentRow][currentCol];
      if (strcmp(key, "<") == 0) {
        if (currentName.length() > 0) currentName.remove(currentName.length() - 1);
      } else if (strcmp(key, "^") == 0) {
        currentName = "";
        return false;
      } else if (strcmp(key, "OK") == 0) {
        return currentName.length() > 0;
      } else if (strcmp(key, "_") == 0) {
        currentName += "_";
      } else {
        currentName += key;
      }
      delay(200);
    } else if (readButton(BUTTON_BACK) == LOW) {
      return false;
    }
  }
}

#define LOGO_WIDTH  128
#define LOGO_HEIGHT 64

const unsigned char logo_data[] PROGMEM = {
  // (Paste your bitmap data here)
	0xff, 0xff, 0xff, 0xff, 0xff, 0xff, 0xff, 0xff, 0xff, 0xff, 0xff, 0xff, 0xff, 0xff, 0xff, 0xff, 
	0xff, 0xff, 0xff, 0xff, 0xff, 0xff, 0xff, 0xff, 0xff, 0xff, 0xff, 0xff, 0xff, 0xff, 0xff, 0xff, 
	0xff, 0xff, 0xff, 0xff, 0xff, 0xff, 0xff, 0xff, 0xff, 0xff, 0xff, 0xff, 0xff, 0xff, 0xff, 0xff, 
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	0xff, 0xff, 0xff, 0xff, 0xff, 0xff, 0xff, 0xff, 0xff, 0xff, 0xff, 0xff, 0xff, 0xff, 0xff, 0xff
};
const unsigned char IR_ICON[] PROGMEM = {
	0x00, 0x00, 0x00, 0x00, 0x00, 0x00, 0x00, 0x00, 0x00, 0x00, 0x00, 0x00, 0x00, 0x00, 0x00, 0x00, 
	0x7e, 0x00, 0x00, 0x00, 0x00, 0x00, 0x7e, 0x00, 0x00, 0x00, 0x00, 0x00, 0xe0, 0x01, 0x00, 0x00, 
	0x00, 0x00, 0xe0, 0x01, 0x00, 0x00, 0x00, 0x00, 0xe0, 0x01, 0x00, 0x00, 0x00, 0x03, 0x06, 0x0e, 
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	0x00, 0x00, 0x00, 0x00, 0x00, 0x00, 0x00, 0x00, 0x00, 0x00, 0x00, 0x00, 0x00, 0x00, 0x00, 0x00
};
const unsigned char SUBGHZ_ICON[] PROGMEM = {
	0x00, 0x00, 0x00, 0x00, 0x00, 0x00, 0x00, 0x30, 0x00, 0x00, 0x00, 0x00, 0x00, 0x18, 0x00, 0x00, 
	0x18, 0x00, 0x00, 0x0c, 0x00, 0x00, 0x30, 0x00, 0x00, 0x04, 0x00, 0x00, 0x60, 0x00, 0x00, 0x86, 
	0x01, 0x00, 0xc3, 0x00, 0x00, 0xc2, 0x00, 0x00, 0x86, 0x00, 0x00, 0x43, 0x00, 0x00, 0x84, 0x01, 
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	0x01, 0x00, 0x01, 0x00, 0x00, 0x00, 0x00, 0x00, 0x00, 0x00, 0x00, 0x00, 0x00, 0x00, 0x00, 0x00
};
const unsigned char NFC_ICON[] PROGMEM = {
	0xf0, 0xff, 0xff, 0x03, 0xfe, 0x0f, 0xf8, 0xff, 0xff, 0x0f, 0xfc, 0x1f, 0xfc, 0xff, 0xff, 0x1f, 
	0xf8, 0x3f, 0xfe, 0xf7, 0xff, 0x3f, 0xf0, 0x7f, 0xff, 0xe7, 0xff, 0x7f, 0xf0, 0xff, 0xff, 0xc7, 
	0xff, 0x7f, 0xe0, 0xff, 0xff, 0x87, 0xff, 0xff, 0xe0, 0xff, 0xff, 0x07, 0xff, 0xff, 0xe0, 0xff, 
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	0xf8, 0xff, 0xff, 0x3f, 0xf8, 0x1f, 0xe0, 0xff, 0xff, 0x1f, 0xf0, 0x3f, 0x80, 0xff, 0xff, 0x0f
};
const unsigned char GAME_ICON[] PROGMEM = {
	0x00, 0x00, 0x00, 0x00, 0x00, 0x00, 0x00, 0x00, 0x00, 0x00, 0x00, 0x00, 0x00, 0x00, 0x00, 0x00, 
	0x00, 0x00, 0x00, 0x00, 0x00, 0x00, 0x00, 0x00, 0x00, 0x00, 0x00, 0x00, 0x00, 0x00, 0x00, 0x00, 
	0x00, 0x00, 0x00, 0x00, 0x00, 0x00, 0x00, 0x00, 0x00, 0x00, 0x00, 0x00, 0x00, 0x00, 0x00, 0x00, 
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	0x00, 0x00, 0x00, 0x00, 0x00, 0x00, 0x00, 0x00, 0x00, 0x00, 0x00, 0x00, 0x00, 0x00, 0x00, 0x00
};
const unsigned char BT_ICON[] PROGMEM = {
	0x00, 0x00, 0x00, 0x00, 0x00, 0x00, 0x00, 0x00, 0x00, 0x00, 0x00, 0x00, 0x00, 0x00, 0x00, 0x00, 
	0x00, 0x00, 0x00, 0x00, 0xe0, 0x0f, 0x00, 0x00, 0x00, 0x00, 0xe0, 0x0f, 0x00, 0x00, 0x00, 0x00, 
	0xf0, 0x3f, 0x00, 0x00, 0x00, 0x00, 0xf0, 0xff, 0x00, 0x00, 0x00, 0x00, 0xf0, 0xff, 0x00, 0x00, 
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	0x00, 0x00, 0x00, 0x00, 0x00, 0x00, 0x00, 0x00, 0x00, 0x00, 0x00, 0x00, 0x00, 0x00, 0x00, 0x00
};
const unsigned char MARAUDER_ICON[] PROGMEM =  {
	0x00, 0x00, 0x00, 0x00, 0x00, 0x00, 0x00, 0x00, 0xf0, 0x0f, 0x00, 0x00, 0x00, 0x80, 0xff, 0xff, 
	0x01, 0x00, 0x00, 0xf0, 0x0f, 0xf0, 0x0f, 0x00, 0x00, 0xfc, 0x00, 0x00, 0x3f, 0x00, 0x00, 0x1f, 
	0x00, 0x00, 0xf8, 0x00, 0xc0, 0x07, 0x00, 0x00, 0xe0, 0x03, 0xe0, 0x01, 0x00, 0x00, 0x80, 0x07, 
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	0xf0, 0x0f, 0x00, 0x00, 0x00, 0x00, 0xe0, 0x07, 0x00, 0x00, 0x00, 0x00, 0x00, 0x00, 0x00, 0x00
};

void showStartupLogo() {
  u8g2.clearBuffer();
  
  // Get display dimensions
  int screenWidth = u8g2.getDisplayWidth();
  int screenHeight = u8g2.getDisplayHeight();
  
  // Calculate centered position
  int x = (screenWidth - LOGO_WIDTH) / 2;
  int y = (screenHeight - LOGO_HEIGHT) / 2;
  
  // Draw the bitmap at the calculated position
  u8g2.setDrawColor(1);
  u8g2.drawXBMP(x, y, LOGO_WIDTH, LOGO_HEIGHT, logo_data);
  u8g2.sendBuffer();
  
  delay(2000); // Display for 2 seconds
}


void setup() {
  Serial.begin(115200);
  u8g2.begin(); 
  u8g2.setContrast(150); 
  showStartupLogo();

  
  Serial.println("Setup started...");

  // Keep both SPI devices deselected while the SD card is initialized.
  pinMode(CC1101_CS, OUTPUT);
  digitalWrite(CC1101_CS, HIGH);
  pinMode(5, OUTPUT);
  digitalWrite(5, HIGH);

  // Initialize the radio before probing an optional SD device. A failed SD
  // probe can leave the shared SPI peripheral in an unusable state.
  InitSubGHz();
  delay(500);
  yield();

  // SD Card Init
  Serial.println("Initializing SD Card...");
  if (useSD) {
    if (!SD.begin(5)) {
      Serial.println("SD card not found.");
      useSD = false;
    } else {
      Serial.println("SD OK!");
      if (!SD.exists("/ir")) SD.mkdir("/ir");
      if (!SD.exists("/rfid")) SD.mkdir("/rfid");
      if (!SD.exists("/subghz")) SD.mkdir("/subghz");
    }
  }

  if (!subGhzRadioReady) {
    Serial.println("Retrying MD1101 after SD initialization...");
    InitSubGHz();
  }
  delay(500);
  yield();

  // Button Init
  pinMode(BUTTON_SELECT, INPUT_PULLUP);
  pinMode(BUTTON_BACK, INPUT_PULLUP);

  pinMode(ANALOG_BUTTONS_PIN, INPUT);
  delay(500);
  yield();

  // Other initialization functions ...
  Initnfc();
  delay(500);
  yield();

  InitIR();
  delay(500);
  yield();

  digitalWrite(CC1101_CS, HIGH);
  digitalWrite(5, HIGH);

  gameSetup();
  delay(500);
  yield();

  InitMarauder();
  delay(500);
  yield();

  Serial.println("Setup finished!");
}


bool marauderModeStarted = false;
bool bluetoothStarted = false;

void loop() {
  switch (currentMode) {
    case MENU:
      displayStartingMenu();
      handleMenuInput();
      break;
    case IR_MODE:
      displayIRMenu();
      HandlebuttonIR();
      break;
    case GAME_MODE:
      gameLoop();
      break;
    case SUBGHZ_MODE:
      displaySubGHzMenu();
      HanldeSubGHzbutton();
      break;
    case NFC_MODE:
      handleNFCMode();
      HandlebuttonNFC();
      break;
    case BLUETOOTH_MODE:
      if (!bluetoothStarted) {
        InitBluetooth();  // lazy start -- see note in setup()
      }
      handleBLEMode();
      HandlebuttonBLE();
      break;
    case MARAUDER_MODE:
      if (!marauderModeStarted) {
        InitMarauder();
        marauderModeStarted = true;
        targetFound = false;
      }
      handleMarauderMode();
      break;
    default:
      break;
  }
}


void handleMenuInput() {

  static int lastButton = -1;
  static int stableButton = -1;
  static unsigned long stateChangeTime = 0;

  int currentButton = -1;

  // ------------------------------------------------------------
  // Read which button is currently pressed
  // ------------------------------------------------------------

  if (readButton(BUTTON_LEFT) == LOW) {
    currentButton = BUTTON_LEFT;
  }
  else if (readButton(BUTTON_RIGHT) == LOW) {
    currentButton = BUTTON_RIGHT;
  }
  else if (readButton(BUTTON_UP) == LOW) {
    currentButton = BUTTON_UP;
  }
  else if (readButton(BUTTON_DOWN) == LOW) {
    currentButton = BUTTON_DOWN;
  }
  else if (readButton(BUTTON_SELECT) == LOW) {
    currentButton = BUTTON_SELECT;
  }
  else if (readButton(BUTTON_BACK) == LOW) {
    currentButton = BUTTON_BACK;
  }


  // ------------------------------------------------------------
  // Detect a change in button state
  // ------------------------------------------------------------

  if (currentButton != lastButton) {

    lastButton = currentButton;
    stateChangeTime = millis();

    return;
  }


  // ------------------------------------------------------------
  // Wait for the button state to remain stable
  // ------------------------------------------------------------

  if (millis() - stateChangeTime < 40) {
    return;
  }


  // ------------------------------------------------------------
  // Only execute when a NEW button press is detected
  // ------------------------------------------------------------

  if (currentButton != stableButton) {

    stableButton = currentButton;

    // Ignore release
    if (stableButton == -1) {
      return;
    }


    // ----------------------------------------------------------
    // LEFT
    // ----------------------------------------------------------

    if (stableButton == BUTTON_LEFT) {

      selectedOption--;

      if (selectedOption < 0) {
        selectedOption = 5;
      }

      Serial.println("BUTTON LEFT");
    }


    // ----------------------------------------------------------
    // RIGHT
    // ----------------------------------------------------------

    else if (stableButton == BUTTON_RIGHT) {

      selectedOption++;

      if (selectedOption > 5) {
        selectedOption = 0;
      }

      Serial.println("BUTTON RIGHT");
    }


    // ----------------------------------------------------------
    // UP
    // ----------------------------------------------------------

    else if (stableButton == BUTTON_UP) {

      Serial.println("BUTTON UP");
    }


    // ----------------------------------------------------------
    // DOWN
    // ----------------------------------------------------------

    else if (stableButton == BUTTON_DOWN) {

      Serial.println("BUTTON DOWN");
    }


    // ----------------------------------------------------------
    // SELECT
    // ----------------------------------------------------------

    else if (stableButton == BUTTON_SELECT) {

      Serial.println("BUTTON SELECT");

      selectOption();
    }


    // ----------------------------------------------------------
    // BACK
    // ----------------------------------------------------------

    else if (stableButton == BUTTON_BACK) {

      Serial.println("BUTTON BACK");

      currentMode = MENU;
    }
  }
}



void selectOption() {
  switch (selectedOption) {
    case 0: 
      currentMode = IR_MODE;  // Switch to IR Mode
      break;
    case 1: 
      selectSubGHzOption = 0;
      currentMode = SUBGHZ_MODE;  // Switch to SubGHz Mode
      break;
    case 2: 
      currentMode = NFC_MODE;  // Switch to NFC Mode
      break;
    case 3: 
      currentMode = GAME_MODE;  // Switch to Game Mode
      break;
    case 4: 
      currentMode = BLUETOOTH_MODE;  // Switch to Bluetooth Mode
      break;
    case 5: 
      currentMode = MARAUDER_MODE;  // Switch to Marauder Mode
      break;
    default: 
      break;
  }
}

void displayStartingMenu() {
  u8g2.clearBuffer();

  const char* menuOptions[] = {"IR Mode", "SubGHz", "NFC Mode", "Game Mode", "Bluetooth", "Marauder"};
  const unsigned char* modeIcons[] = {IR_ICON, SUBGHZ_ICON, NFC_ICON, GAME_ICON, BT_ICON, MARAUDER_ICON};
  int totalOptions = sizeof(menuOptions) / sizeof(menuOptions[0]);


  if (totalOptions == 0) {
    return;
  }

  if (selectedOption < 0 || selectedOption >= totalOptions) {
    selectedOption = 0;
  }

  if (modeIcons[selectedOption] == NULL) {
    return;
  }

  u8g2.drawXBMP((128 - 48) / 2, 5, 48, 48, modeIcons[selectedOption]);

  if (menuOptions[selectedOption] == NULL) {
    return;
  }

  u8g2.setFont(u8g2_font_squeezed_b6_tr);
  int textWidth = u8g2.getStrWidth(menuOptions[selectedOption]);

  if (textWidth == 0) {
    return;
  }

  u8g2.setCursor((128 - textWidth) / 2, 60);
  u8g2.print(menuOptions[selectedOption]);

  u8g2.sendBuffer();
}




void exitMode() {
  currentMode = MENU;
}
